## boards/shields/Lily58/Kconfig.defconfig
```kconfig
if SHIELD_LILY58_L

config ZMK_KEYBOARD_NAME
    default "Lily58"

config ZMK_SPLIT_ROLE_CENTRAL
    default y

endif

if SHIELD_LILY58_L || SHIELD_LILY58_R

config ZMK_SPLIT
    default y

if LVGL

config LV_Z_VDB_SIZE
    default 64

config LV_DPI_DEF
    default 148

config LV_Z_BITS_PER_PIXEL
    default 1

choice LV_COLOR_DEPTH
    default LV_COLOR_DEPTH_1
endchoice

endif # LVGL

endif
```
